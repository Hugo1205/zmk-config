/*
 * Copyright (c) 2020 Pete Johanson
 *
 * SPDX-License-Identifier: MIT
 */

#include "corne.dtsi"

&kscan0 {
    col-gpios
        = <&pro_micro 21 GPIO_ACTIVE_HIGH>
        , <&pro_micro 20 GPIO_ACTIVE_HIGH>
        , <&pro_micro 19 GPIO_ACTIVE_HIGH>
        , <&pro_micro 18 GPIO_ACTIVE_HIGH>
        , <&pro_micro 15 GPIO_ACTIVE_HIGH>
        , <&pro_micro 14 GPIO_ACTIVE_HIGH>
        ;
};

&spi0 {
    status = "okay";
    compatible = "nordic,nrf-spim";
    pinctrl-0 = <&spi0_default>;
    pinctrl-1 = <&spi0_sleep>;
    pinctrl-names = "default", "sleep";
    cs-gpios = <&gpio0 10 GPIO_ACTIVE_LOW>;

    epd: il0323@0 {
        compatible = "gooddisplay,il0323";
        reg =  <0>;
        width = <80>;
        height = <128>;
        spi-max-frequency = <4000000>;
        dc-gpios = <&gpio0 9 GPIO_ACTIVE_LOW>;
        busy-gpios = <&gpio1 6 GPIO_ACTIVE_LOW>;
        reset-gpios = <&gpio1 4 GPIO_ACTIVE_LOW>;
        pwr = [03 00 26 26];
        cdi = <0xd2>;
        tcon = <0x22>;
    };
};

// vim: filetype=dts fdm=marker:
